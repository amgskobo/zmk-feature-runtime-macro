## tests/queue-kernel/Kconfig
```kconfig
mainmenu "Runtime macro real-kernel queue boundary"
source "Kconfig.zephyr"
config ZMK_LOG_LEVEL
    int
    default 0
config ZMK_BEHAVIORS_QUEUE_SIZE
    int
    default 64
```

## tests/queue-pressure/module/Kconfig
```kconfig
# SPDX-License-Identifier: MIT
config RUNTIME_MACRO_PRESSURE_TEST
    bool "Test macro queue pressure against the actual kernel and behavior queue"
```
